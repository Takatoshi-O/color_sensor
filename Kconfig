## Kconfig
```kconfig
menu "Color Sensor Configuration"

    config COLOR_SENSOR_I2C_PORT
        int "I2Cポート番号"
        default 0

    config COLOR_SENSOR_SDA_GPIO
        int "I2C SDA GPIO番号"
        default 5
        help
            TCS34725/PCA9548Aが接続されるI2CバスのSDAピンです。

    config COLOR_SENSOR_SCL_GPIO
        int "I2C SCL GPIO番号"
        default 6
        help
            TCS34725/PCA9548Aが接続されるI2CバスのSCLピンです。

    config COLOR_SENSOR_I2C_FREQ_HZ
        int "I2Cクロック周波数(Hz)"
        default 100000

    config COLOR_SENSOR_PCA9548_ADDR
        hex "PCA9548AのI2Cアドレス"
        default 0x70

    config COLOR_SENSOR_CHANNEL_COUNT
        int "使用するセンサーチャンネル数"
        default 2
        range 1 8
        help
            初期化時にループする、PCA9548Aの使用チャンネル数(0chから連番)。

endmenu
```
